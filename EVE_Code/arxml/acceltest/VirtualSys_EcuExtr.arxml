AUTOSAR XML (schema 4-2-1)
package /VirtualSys_EcuExtract
  system EXTR_EcuInstance_0: category=ECU_EXTRACT
    system mapping SYSMPG_EcuInstance_0
      sw-mappings:
        swc to ecu mapping SwcToEcuMapping_0: ecu-instance=EcuInstance_0
          component:
            CPT_EcuInstance_0_FlatView.CPT_Algo
            CPT_EcuInstance_0_FlatView.CPT_BEA
            CPT_EcuInstance_0_FlatView.CPT_EEA
            CPT_EcuInstance_0_FlatView.CPT_EcuAbstraction
            CPT_EcuInstance_0_FlatView.CPT_SensorSWComponent
    root-software-compositions:
      root sw composition prototype CPT_EcuInstance_0_FlatView: flat-map=EcuInstance_0_FlatMap, software-composition=EcuInstance_0_FlatView
