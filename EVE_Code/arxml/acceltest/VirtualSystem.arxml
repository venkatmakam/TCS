AUTOSAR XML (schema 4-2-1)
package /VirtualSystem
  system VirtualSys: category=SYSTEM_EXTRACT
    system mapping SystemMapping_0
      sw-mappings:
        swc to ecu mapping SwcToEcuMapping_0: ecu-instance=EcuInstance_0
          component:
            RootSwCompositionPrototype_0.CPT_Algo
            RootSwCompositionPrototype_0.CPT_BEA
            RootSwCompositionPrototype_0.CPT_EEA
            RootSwCompositionPrototype_0.CPT_EcuAbstraction
            RootSwCompositionPrototype_0.CPT_SensorSWComponent
    root-software-compositions:
      root sw composition prototype RootSwCompositionPrototype_0: software-composition=TopComposition
  ecu instance EcuInstance_0
