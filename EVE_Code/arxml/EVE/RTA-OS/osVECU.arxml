AUTOSAR XML (schema 4-0-2)
package /OS_CFG
  module config Os_0: definition=Os
    OSDEFAULTAPPMODE (OsAppMode)
    RTE_RESOURCE (OsResource)
    OsInfo (OsOS):
      OsScalabilityClass = SC1
      OsStatus = STANDARD
      OsStackMonitoring = false
      OsUseGetServiceId = false
      OsUseParameterAccess = false
      OsUseResScheduler = true
      OsCyclesPerSecond = 1000000
      OsTicksPerSecond = 1000
      HooksContainer (OsHooks): OsStartupHook=true, OsShutdownHook=true, OsPreTaskHook=false, OsPostTaskHook=false, OsStackFaultHook=false, OsProtectionHook=false, OsErrorHook=false
      meter_execution (Param): Value=false
      no_timing_protection (Param): Value=false
    VECU_SystemClock_ISR (OsIsr): OsIsrCategory=CATEGORY_2, OsIsrPriority=5, OsIsrAddress=7
