AUTOSAR XML (schema 4-0-2)
standard types defined: uint8, float64
package /AUTOSAR_Rte/BswModuleDescriptions
  bsw module description RteBswModuleDescription: provided-entrys=[Rte_Start, Rte_Stop, SchM_DeInit, SchM_Init]
    bsw module dependency ModDepOS: target-module-id=001
      required-entrys:
        ActivateTask
        CancelAlarm
        ClearEvent
        GetEvent
        GetResource
        GetTaskID
        ReleaseResource
        ResumeOSInterrupts
        SetEvent
        SetRelAlarm
        SuspendOSInterrupts
        TerminateTask
        WaitEvent
    bsw internal behavior RteInternalBehavior
      constant-memorys:
        11 x parameter data prototype:
          Rte_Inst_Algo: type=Rte_CDS_Algo
          Rte_Inst_BEA: type=Rte_CDS_BEA
          Rte_Inst_EEA: type=Rte_CDS_EEA
          Rte_Inst_EcuAbstraction: type=Rte_CDS_EcuAbstraction
          Rte_Inst_SensorSWComponent: type=Rte_CDS_SensorSWComponent
          Rte_Self_CPT_Algo: type=Rte_SelfType_Algo
          Rte_Self_CPT_BEA: type=Rte_SelfType_BEA
          Rte_Self_CPT_EEA: type=Rte_SelfType_EEA
          Rte_Self_CPT_EcuAbstraction: type=Rte_SelfType_EcuAbstraction
          Rte_Self_CPT_SensorSWComponent: type=Rte_SelfType_SensorSWComponent
          Rte_Tasks: type=Rte_TaskInfo
      static-memorys:
        data Throttle: type=float64
      4 x bsw called entity:
        BCERte_Start: implemented-entry=Rte_Start
        BCERte_Stop: implemented-entry=Rte_Stop
        BCESchM_DeInit: implemented-entry=SchM_DeInit
        BCESchM_Init: implemented-entry=SchM_Init
package /AUTOSAR_Rte/BswModuleEntrys
  4 x bsw module entry:
    Rte_Start
    Rte_Stop
    SchM_DeInit
    SchM_Init
package /AUTOSAR_Rte/BswImplementations
  bsw implementation Rte: programming-language=C, sw-version=0.0.0, used-code-generator=ETAS RTEGen, ar-release-version=4.0.0, behavior=RteInternalBehavior
    generated-artifacts:
      40 x dependency on artifact:
        Algo_MemMap_h: artifact-descriptor={short-label=Algo_MemMap_h, category=SWHDR, domain=AUTOSAR}
        BEA_MemMap_h: artifact-descriptor={short-label=BEA_MemMap_h, category=SWHDR, domain=AUTOSAR}
        Com_h: artifact-descriptor={short-label=Com_h, category=SWHDR, domain=AUTOSAR}
        EEA_MemMap_h: artifact-descriptor={short-label=EEA_MemMap_h, category=SWHDR, domain=AUTOSAR}
        EcuAbstraction_MemMap_h: artifact-descriptor={short-label=EcuAbstraction_MemMap_h, category=SWHDR, domain=AUTOSAR}
        Ioc_h: artifact-descriptor={short-label=Ioc_h, category=SWHDR, domain=AUTOSAR}
        MemMap_h: artifact-descriptor={short-label=MemMap_h, category=SWHDR, domain=AUTOSAR}
        NvM_h: artifact-descriptor={short-label=NvM_h, category=SWHDR, domain=AUTOSAR}
        Os_h: artifact-descriptor={short-label=Os_h, category=SWHDR, domain=AUTOSAR}
        OsTask_0_c: artifact-descriptor={short-label=OsTask_0_c, category=SWSRC, domain=AUTOSAR}
        OsTask_0_h: artifact-descriptor={short-label=OsTask_0_h, category=SWHDR, domain=AUTOSAR}
        OsTask_1_c: artifact-descriptor={short-label=OsTask_1_c, category=SWSRC, domain=AUTOSAR}
        OsTask_1_h: artifact-descriptor={short-label=OsTask_1_h, category=SWHDR, domain=AUTOSAR}
        Rte_c: artifact-descriptor={short-label=Rte_c, category=SWSRC, domain=AUTOSAR}
        Rte_h: artifact-descriptor={short-label=Rte_h, category=SWHDR, domain=AUTOSAR}
        Rte_Algo_c: artifact-descriptor={short-label=Rte_Algo_c, category=SWSRC, domain=AUTOSAR}
        Rte_Algo_h: artifact-descriptor={short-label=Rte_Algo_h, category=SWHDR, domain=AUTOSAR}
        Rte_Algo_Type_h: artifact-descriptor={short-label=Rte_Algo_Type_h, category=SWHDR, domain=AUTOSAR}
        Rte_BEA_c: artifact-descriptor={short-label=Rte_BEA_c, category=SWSRC, domain=AUTOSAR}
        Rte_BEA_h: artifact-descriptor={short-label=Rte_BEA_h, category=SWHDR, domain=AUTOSAR}
        Rte_BEA_Type_h: artifact-descriptor={short-label=Rte_BEA_Type_h, category=SWHDR, domain=AUTOSAR}
        Rte_Cbk_h: artifact-descriptor={short-label=Rte_Cbk_h, category=SWHDR, domain=AUTOSAR}
        Rte_Cfg_h: artifact-descriptor={short-label=Rte_Cfg_h, category=SWHDR, domain=AUTOSAR}
        Rte_Const_h: artifact-descriptor={short-label=Rte_Const_h, category=SWHDR, domain=AUTOSAR}
        Rte_DataHandleType_h: artifact-descriptor={short-label=Rte_DataHandleType_h, category=SWHDR, domain=AUTOSAR}
        Rte_EEA_c: artifact-descriptor={short-label=Rte_EEA_c, category=SWSRC, domain=AUTOSAR}
        Rte_EEA_h: artifact-descriptor={short-label=Rte_EEA_h, category=SWHDR, domain=AUTOSAR}
        Rte_EEA_Type_h: artifact-descriptor={short-label=Rte_EEA_Type_h, category=SWHDR, domain=AUTOSAR}
        Rte_EcuAbstraction_c: artifact-descriptor={short-label=Rte_EcuAbstraction_c, category=SWSRC, domain=AUTOSAR}
        Rte_EcuAbstraction_h: artifact-descriptor={short-label=Rte_EcuAbstraction_h, category=SWHDR, domain=AUTOSAR}
        Rte_EcuAbstraction_Type_h: artifact-descriptor={short-label=Rte_EcuAbstraction_Type_h, category=SWHDR, domain=AUTOSAR}
        Rte_Hook_h: artifact-descriptor={short-label=Rte_Hook_h, category=SWHDR, domain=AUTOSAR}
        Rte_Intl_h: artifact-descriptor={short-label=Rte_Intl_h, category=SWHDR, domain=AUTOSAR}
        Rte_Lib_c: artifact-descriptor={short-label=Rte_Lib_c, category=SWSRC, domain=AUTOSAR}
        Rte_Main_h: artifact-descriptor={short-label=Rte_Main_h, category=SWHDR, domain=AUTOSAR}
        Rte_SensorSWComponent_c: artifact-descriptor={short-label=Rte_SensorSWComponent_c, category=SWSRC, domain=AUTOSAR}
        Rte_SensorSWComponent_h: artifact-descriptor={short-label=Rte_SensorSWComponent_h, category=SWHDR, domain=AUTOSAR}
        Rte_SensorSWComponent_Type_h: artifact-descriptor={short-label=Rte_SensorSWComponent_Type_h, category=SWHDR, domain=AUTOSAR}
        Rte_Type_h: artifact-descriptor={short-label=Rte_Type_h, category=SWHDR, domain=AUTOSAR}
        SensorSWComponent_MemMap_h: artifact-descriptor={short-label=SensorSWComponent_MemMap_h, category=SWHDR, domain=AUTOSAR}
    resource consumption ResConsumption
      4 x memory section:
        CODE: alignment=UNSPECIFIED, sw-addrmethod=CODE
        CONST_UNSPECIFIED: alignment=UNSPECIFIED, sw-addrmethod=CONST_UNSPECIFIED
        TASKBODY: alignment=UNSPECIFIED, sw-addrmethod=TASKBODY
        VAR_64BIT: alignment=64, sw-addrmethod=VAR_64BIT
package /AUTOSAR_Rte/DataConstrs
  range DataConstraints_DataConstr_uint8: phys 0..255, raw 0..255
package /AUTOSAR_Rte/ImplementationDataTypes
  11 x impl type:
    Rte_CDS_Algo: category=STRUCTURE
      element _dummy: implementation-data-type=uint8
    Rte_CDS_BEA: category=STRUCTURE
      element _dummy: implementation-data-type=uint8
    Rte_CDS_EEA: category=STRUCTURE
      element _dummy: implementation-data-type=uint8
    Rte_CDS_EcuAbstraction: category=STRUCTURE
      element _dummy: implementation-data-type=uint8
    Rte_CDS_SensorSWComponent: category=STRUCTURE
      element _dummy: implementation-data-type=uint8
    Rte_SelfType_Algo: implementation-data-type=Rte_CDS_Algo
    Rte_SelfType_BEA: implementation-data-type=Rte_CDS_BEA
    Rte_SelfType_EEA: implementation-data-type=Rte_CDS_EEA
    Rte_SelfType_EcuAbstraction: implementation-data-type=Rte_CDS_EcuAbstraction
    Rte_SelfType_SensorSWComponent: implementation-data-type=Rte_CDS_SensorSWComponent
    Rte_TaskInfo: category=VALUE  # This is an external type, i.e. it is declared in the Rte Library and not in the XML. RTEGen does not have any information about this type apart from its name.
package /AUTOSAR_Rte/SwAddrMethods
  4 x sw addr method:
    CODE: section-type=CODE
    CONST_UNSPECIFIED: section-type=CONST
    TASKBODY: section-type=CODE
    VAR_64BIT: section-type=VAR
