AUTOSAR XML (schema 4-0-3)
package /OS_CFG
  module config Os_0: definition=Os
    RTE_RESOURCE (OsResource): OsResourceProperty=STANDARD
    OsTask_0 (OsTask): OsTaskSchedule=FULL, OsTaskActivation=1, OsTaskPriority=1, OsTaskResourceRef=RTE_RESOURCE
    OsTask_1 (OsTask): OsTaskSchedule=FULL, OsTaskActivation=1, OsTaskPriority=1, OsTaskResourceRef=RTE_RESOURCE
    Rte_TickCounter (OsCounter): OsCounterMaxAllowedValue=65535, OsCounterMinCycle=1, OsCounterTicksPerBase=1, OsCounterType=SOFTWARE
    Rte_ScheduleTable (OsScheduleTable): OsScheduleTableRepeating=true, OsScheduleTableDuration=1, OsScheduleTableCounterRef=Rte_TickCounter
      rte_Stimulus_1 (OsScheduleTableExpiryPoint): OsScheduleTblExpPointOffset=0
        TaskActivation1 (OsScheduleTableTaskActivation): OsScheduleTableActivateTaskRef=OsTask_0
        TaskActivation2 (OsScheduleTableTaskActivation): OsScheduleTableActivateTaskRef=OsTask_1
