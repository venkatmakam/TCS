AUTOSAR XML (schema 4-2-1)
package /EcuInstance_0_FlatView
  flat map EcuInstance_0_FlatMap
    6 x flat instance descriptor:
      CPT_Algo: upstream-reference=RootSwCompositionPrototype_0.CPT_Algo, ecu-extract-reference=CPT_EcuInstance_0_FlatView.CPT_Algo
      Throttle: upstream-reference=RootSwCompositionPrototype_0.CPT_Algo.Engine_PPort.Throttle, ecu-extract-reference=CPT_EcuInstance_0_FlatView.CPT_Algo.Engine_PPort.Throttle
      CPT_BEA: upstream-reference=RootSwCompositionPrototype_0.CPT_BEA, ecu-extract-reference=CPT_EcuInstance_0_FlatView.CPT_BEA
      CPT_EEA: upstream-reference=RootSwCompositionPrototype_0.CPT_EEA, ecu-extract-reference=CPT_EcuInstance_0_FlatView.CPT_EEA
      CPT_EcuAbstraction: upstream-reference=RootSwCompositionPrototype_0.CPT_EcuAbstraction, ecu-extract-reference=CPT_EcuInstance_0_FlatView.CPT_EcuAbstraction
      CPT_SensorSWComponent: upstream-reference=RootSwCompositionPrototype_0.CPT_SensorSWComponent, ecu-extract-reference=CPT_EcuInstance_0_FlatView.CPT_SensorSWComponent
