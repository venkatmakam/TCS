AUTOSAR XML (schema 4-2-1)
package /EcuInstance_0_FlatView/SwComponentTypes
  composition sw component type EcuInstance_0_FlatView
    5 x component:
      CPT_Algo: type=Algo
      CPT_BEA: type=BEA
      CPT_EEA: type=EEA
      CPT_EcuAbstraction: type=EcuAbstraction
      CPT_SensorSWComponent: type=SensorSWComponent
    connect CPT_EcuAbstraction.Sensor_PPort -> CPT_SensorSWComponent.Sensor_RPort
    connect CPT_Algo.SensorToAlgo_PPort -> CPT_SensorSWComponent.SensorTOAlgo_RPort
    connect CPT_BEA.BrakeValue_PPort -> CPT_Algo.BrakeValue_RPort
    connect CPT_Algo.Engine_PPort -> CPT_EEA.Throttle_RPort
    connect CPT_EcuAbstraction.Throttle_PPort -> CPT_EEA.ThrottleToECU_RPort
    connect CPT_EcuAbstraction.BrakeValue_PPort -> CPT_BEA.BrakeValueTOECU_RPort
