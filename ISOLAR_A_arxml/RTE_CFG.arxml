AUTOSAR XML (schema 4-2-1)
package /RTE_CFG
  module config Rte_0: definition=Rte
    CPT_EEA (RteSwComponentInstance): RteSoftwareComponentInstanceRef=CPT_EEA
      TimingEvent_Receive (RteEventToTaskMapping): RtePositionInTask=1, RteActivationOffset=0.0, RteMappedToTaskRef=OsTask_0, RteEventRef=TimingEvent_Receive
    RteGeneration_0 (RteGeneration):
      RteGenerationMode = VENDOR_MODE
      RteCalibrationSupport = NONE
      RteDevErrorDetect = false
      RteDevErrorDetectUninit = false
      RteIocInteractionReturnValue = RTE_COM
      RteMeasurementSupport = true
      RteOptimizationMode = RUNTIME
      RteToolChainSignificantCharacters = 127
      RteVfbTraceEnabled = false
    CPT_SensorSWComponent (RteSwComponentInstance): RteSoftwareComponentInstanceRef=CPT_SensorSWComponent
      TimingEvent (RteEventToTaskMapping): RtePositionInTask=1, RteActivationOffset=0.0, RteMappedToTaskRef=OsTask_1, RteEventRef=TimingEvent
