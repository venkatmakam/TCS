AUTOSAR XML (schema 4-0-3)
package /Types
  app type STATE_WIPING: category=VALUE, sw-calibration-access=READ-WRITE, compu {0=ENUM_STATE_WIPING_STOP, 1=ENUM_STATE_WIPING_RESERVE, 2=ENUM_STATE_WIPING_LOW_VAR_SPEED, 3=ENUM_STATE_WIPING_HIGH_SPEED}, range phys 0..3, raw 0..3
  app type SPEED_WIPING: category=VALUE, sw-calibration-access=READ-WRITE, compu {15=ENUM_SPEED_WIP_SPEED_HIGH, 14=ENUM_SPEED_WIP_SPEED_14, 1=ENUM_SPEED_WIP_SPEED_01, 0=ENUM_SPEED_WIP_SPEED_LOW}, range phys 0..15, raw 0..15
  app type WIPER_POSITION: category=VALUE, sw-calibration-access=READ-WRITE, compu {1=ENUM_WIPER_POSITION_PARK, 0=ENUM_WIPER_POSITION_NOT_PARK}, data-constr=DataConstr_boolean
  app type SIGNAL_QUALIFIER: category=VALUE, sw-calibration-access=READ-WRITE, compu {1=SIGNAL_OK, 0=SIGNAL_NOT_OK}, data-constr=DataConstr_boolean
  app type STATE_LIGHT: category=VALUE, compu {1=ON, 0=OFF}, data-constr=DataConstr_boolean
  app type STATE_EMERGENCY_BUTTON: category=VALUE, sw-calibration-access=READ-WRITE, compu {1=ENUM_STATE_EMERGENCY_BUTTON_ON, 0=ENUM_STATE_EMERGENCY_BUTTON_OFF}, data-constr=DataConstr_boolean
  app type A_LightDark: category=VALUE, sw-calibration-access=READ-WRITE, compu {identical}, range phys 97..254, raw 97..254
  app type WP_WIPER_STATE: category=VALUE, sw-calibration-access=READ-WRITE, compu {0=ENUM_WIPER_STATE_PARK, 1=ENUM_WIPER_STATE_WIPING, 2=ENUM_WIPER_STATE_SERVICE, 3=ENUM_WIPER_STATE_RESERVED}, range phys 0..3, raw 0..3
  app type WP_WIPER_ANG: category=VALUE, sw-calibration-access=READ-WRITE, compu {identical}, range phys 0..180, raw 0..180
  app type WP_WIP: category=VALUE, sw-calibration-access=READ-WRITE, compu {0=ENUM_WIP_RESERVE, 1=ENUM_WIP_STOP_IN_PARK, 2=ENUM_WIP_STOP_IN_SERVICE, 3=ENUM_WIP_STOP_NOW, 4=ENUM_WIP_WIPE_NOW}, range phys 0..4, raw 0..4
  app type WP_SPEED: category=VALUE, sw-calibration-access=READ-WRITE, compu {0=ENUM_WIP_SPEED_SLOW (ENUM_SPEED_SLOW), 15=ENUM_WIP_SPEED_FAST (ENUM_SPEED_FAST)}, range phys 0..15, raw 0..15
  app type WP_WIP_AUTO: category=VALUE, sw-calibration-access=READ-WRITE, compu {1=AUTO_ENABLED, 0=AUTO_DISABLED}, data-constr=DataConstr_boolean
  app type WP_WIP_MAN: category=VALUE, sw-calibration-access=READ-WRITE, compu {1=MANUAL, 0=NOT_MANUAL}, data-constr=DataConstr_boolean
  app type A_LimitsPercent: category=VALUE, sw-calibration-access=READ-WRITE, compu {identical}, range phys 0..100, raw 0..100
  app type A_LightOnOffTime: category=VALUE, sw-calibration-access=READ-ONLY, compu {raw=phys*10 for phys 0..5}, range phys 0..5, raw 0..50
  app type STATE_LIGHT_WIP_SWITCH: category=VALUE, sw-calibration-access=READ-WRITE, compu {1=ENUM_STATE_LIGHT_WIP_SWITCH_ON, 0=ENUM_STATE_LIGHT_WIP_SWITCH_OFF, 2=ENUM_STATE_LIGHT_WIP_SWITCH_AUTO}, range phys 0..2, raw 0..2
  app type STATE_IGNITION_SWITCH: category=VALUE, sw-calibration-access=READ-WRITE, compu {1=ENUM_STATE_IGNITION_SWITCH_ON, 0=ENUM_STATE_IGNITION_SWITCH_OFF}, data-constr=DataConstr_boolean
package /Types/TypeRefs
  17 x impl type, all with category=TYPE_REFERENCE:
    I_uint8_0_100: implementation-data-type=uint8
    SPEED_WIPING: implementation-data-type=uint8
    WP_SPEED: implementation-data-type=uint8
    I_uint8_0_180: implementation-data-type=uint8
    STATE_LIGHT_WIP_SWITCH: implementation-data-type=uint8
    STATE_WIPING: implementation-data-type=uint8
    WP_WIPER_STATE: implementation-data-type=uint8
    WP_WIP: implementation-data-type=uint8
    I_uint8_0_50: implementation-data-type=uint8
    I_uint8_97_254: implementation-data-type=uint8
    STATE_IGNITION_SWITCH: implementation-data-type=boolean
    STATE_LIGHT: implementation-data-type=boolean
    SIGNAL_QUALIFIER: implementation-data-type=boolean
    STATE_EMERGENCY_BUTTON: implementation-data-type=boolean
    WIPER_POSITION: implementation-data-type=boolean
    WP_WIP_AUTO: implementation-data-type=boolean
    WP_WIP_MAN: implementation-data-type=boolean
