AUTOSAR XML (schema 4-2-1)
package /Interface
  client server interface OUT_CS_IF_Sensor
    operation ClientServerOperation_Sensor
      7 x arg, all with type=float64, direction=OUT:
        DLWheelSpeed
        DRWheelSpeed
        ULWheelSpeed
        URWheelSpeed
        CarSpeed
        SteeringAngle
        Gyro
  sender receiver interface SR_IF_Throttle
    data Throttle: type=float64
  client server interface IN_CS_IF_Sensor
    operation ClientServerOperation_Sensor
      7 x arg, all with type=float64, direction=IN:
        DLWheelSpeed
        DRWheelSpeed
        ULWheelSpeed
        URWheelSpeed
        Gyro
        CarSpeed
        SteeringAngle
  client server interface IN_CS_IF_BrakeValue
    operation ClientServerOperation_Brake
      4 x arg, all with type=float64, direction=IN:
        DLBrakeValue
        DRBrakeValue
        ULBrakeValue
        URBrakeValue
  client server interface IN_CS_IF_Throttle
    operation ClientServerOperation_Throttle
      arg Throttle: type=float64, direction=IN
