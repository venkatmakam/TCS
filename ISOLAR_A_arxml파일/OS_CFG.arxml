AUTOSAR XML (schema 4-2-1)
package /OS_CFG
  module config Os_0: definition=Os
    OsTask_0 (OsTask): OsTaskPriority=1, OsTaskActivation=1
    OsTask_1 (OsTask): OsTaskPriority=1, OsTaskActivation=1
