AUTOSAR XML (schema 4-0-2)
standard types defined: float64
package /AUTOSAR_Rte/BswModuleDescriptions
  bsw module description RteBswModuleDescription: provided-entrys=[Rte_Start, Rte_Stop, SchM_DeInit, SchM_Init]
    bsw module dependency ModDepOS: target-module-id=001
      required-entrys:
        ActivateTask
        CancelAlarm
        ClearEvent
        GetEvent
        GetResource
        GetTaskID
        ReleaseResource
        ResumeOSInterrupts
        SetEvent
        SetRelAlarm
        SuspendOSInterrupts
        TerminateTask
        WaitEvent
    bsw internal behavior RteInternalBehavior
      constant-memorys:
        parameter data prototype Rte_Tasks: type=Rte_TaskInfo
      static-memorys:
        data Throttle: type=float64
      4 x bsw called entity:
        BCERte_Start: implemented-entry=Rte_Start
        BCERte_Stop: implemented-entry=Rte_Stop
        BCESchM_DeInit: implemented-entry=SchM_DeInit
        BCESchM_Init: implemented-entry=SchM_Init
package /AUTOSAR_Rte/BswModuleEntrys
  4 x bsw module entry:
    Rte_Start
    Rte_Stop
    SchM_DeInit
    SchM_Init
package /AUTOSAR_Rte/BswImplementations
  bsw implementation Imp: programming-language=C, sw-version=0.0.0, used-code-generator=ETAS RTEGen, ar-release-version=4.0.0, behavior=RteInternalBehavior
    generated-artifacts:
      34 x dependency on artifact:
        Com_h: artifact-descriptor={short-label=Com_h, category=SWHDR, domain=AUTOSAR}
        Ioc_h: artifact-descriptor={short-label=Ioc_h, category=SWHDR, domain=AUTOSAR}
        NvM_h: artifact-descriptor={short-label=NvM_h, category=SWHDR, domain=AUTOSAR}
        Os_h: artifact-descriptor={short-label=Os_h, category=SWHDR, domain=AUTOSAR}
        OsTask_0_c: artifact-descriptor={short-label=OsTask_0_c, category=SWSRC, domain=AUTOSAR}
        OsTask_0_h: artifact-descriptor={short-label=OsTask_0_h, category=SWHDR, domain=AUTOSAR}
        OsTask_1_c: artifact-descriptor={short-label=OsTask_1_c, category=SWSRC, domain=AUTOSAR}
        OsTask_1_h: artifact-descriptor={short-label=OsTask_1_h, category=SWHDR, domain=AUTOSAR}
        Rte_c: artifact-descriptor={short-label=Rte_c, category=SWSRC, domain=AUTOSAR}
        Rte_h: artifact-descriptor={short-label=Rte_h, category=SWHDR, domain=AUTOSAR}
        Rte_Algo_c: artifact-descriptor={short-label=Rte_Algo_c, category=SWSRC, domain=AUTOSAR}
        Rte_Algo_h: artifact-descriptor={short-label=Rte_Algo_h, category=SWHDR, domain=AUTOSAR}
        Rte_Algo_Type_h: artifact-descriptor={short-label=Rte_Algo_Type_h, category=SWHDR, domain=AUTOSAR}
        Rte_BEA_c: artifact-descriptor={short-label=Rte_BEA_c, category=SWSRC, domain=AUTOSAR}
        Rte_BEA_h: artifact-descriptor={short-label=Rte_BEA_h, category=SWHDR, domain=AUTOSAR}
        Rte_BEA_Type_h: artifact-descriptor={short-label=Rte_BEA_Type_h, category=SWHDR, domain=AUTOSAR}
        Rte_Cbk_h: artifact-descriptor={short-label=Rte_Cbk_h, category=SWHDR, domain=AUTOSAR}
        Rte_Cfg_h: artifact-descriptor={short-label=Rte_Cfg_h, category=SWHDR, domain=AUTOSAR}
        Rte_Const_h: artifact-descriptor={short-label=Rte_Const_h, category=SWHDR, domain=AUTOSAR}
        Rte_DataHandleType_h: artifact-descriptor={short-label=Rte_DataHandleType_h, category=SWHDR, domain=AUTOSAR}
        Rte_EEA_c: artifact-descriptor={short-label=Rte_EEA_c, category=SWSRC, domain=AUTOSAR}
        Rte_EEA_h: artifact-descriptor={short-label=Rte_EEA_h, category=SWHDR, domain=AUTOSAR}
        Rte_EEA_Type_h: artifact-descriptor={short-label=Rte_EEA_Type_h, category=SWHDR, domain=AUTOSAR}
        Rte_EcuAbstraction_c: artifact-descriptor={short-label=Rte_EcuAbstraction_c, category=SWSRC, domain=AUTOSAR}
        Rte_EcuAbstraction_h: artifact-descriptor={short-label=Rte_EcuAbstraction_h, category=SWHDR, domain=AUTOSAR}
        Rte_EcuAbstraction_Type_h: artifact-descriptor={short-label=Rte_EcuAbstraction_Type_h, category=SWHDR, domain=AUTOSAR}
        Rte_Hook_h: artifact-descriptor={short-label=Rte_Hook_h, category=SWHDR, domain=AUTOSAR}
        Rte_Intl_h: artifact-descriptor={short-label=Rte_Intl_h, category=SWHDR, domain=AUTOSAR}
        Rte_Lib_c: artifact-descriptor={short-label=Rte_Lib_c, category=SWSRC, domain=AUTOSAR}
        Rte_Main_h: artifact-descriptor={short-label=Rte_Main_h, category=SWHDR, domain=AUTOSAR}
        Rte_SensorSWComponent_c: artifact-descriptor={short-label=Rte_SensorSWComponent_c, category=SWSRC, domain=AUTOSAR}
        Rte_SensorSWComponent_h: artifact-descriptor={short-label=Rte_SensorSWComponent_h, category=SWHDR, domain=AUTOSAR}
        Rte_SensorSWComponent_Type_h: artifact-descriptor={short-label=Rte_SensorSWComponent_Type_h, category=SWHDR, domain=AUTOSAR}
        Rte_Type_h: artifact-descriptor={short-label=Rte_Type_h, category=SWHDR, domain=AUTOSAR}
    resource consumption ResConsumption
      memory section CONST_UNSPECIFIED: alignment=UNSPECIFIED, sw-addrmethod=CONST_UNSPECIFIED
      memory section VAR_64BIT: alignment=64, sw-addrmethod=VAR_64BIT
package /AUTOSAR_Rte/ImplementationDataTypes
  impl type Rte_TaskInfo: category=VALUE  # This is an external type, i.e. it is declared in the Rte Library and not in the XML. RTEGen does not have any information about this type apart from its name.
package /AUTOSAR_Rte/SwAddrMethods
  sw addr method CONST_UNSPECIFIED: section-type=CONST
  sw addr method VAR_64BIT: section-type=VAR
